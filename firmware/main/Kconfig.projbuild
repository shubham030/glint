## firmware/main/Kconfig.projbuild
```kconfig
menu "glint board"

choice GLINT_BOARD
    prompt "Target board"
    default GLINT_BOARD_P4_LCD35 if IDF_TARGET_ESP32P4
    default GLINT_BOARD_S3_AMOLED175 if IDF_TARGET_ESP32S3
    help
        Which panel this firmware drives. The host learns the geometry from the
        HELLO handshake, so a different panel needs no host change.

config GLINT_BOARD_P4_LCD35
    bool "ESP32-P4-WIFI6-Touch-LCD-3.5 (ST7796 SPI, 320x480)"
    depends on IDF_TARGET_ESP32P4

config GLINT_BOARD_S3_AMOLED175
    bool "Waveshare ESP32-S3-Touch-AMOLED-1.75 (CO5300 QSPI, 466x466)"
    depends on IDF_TARGET_ESP32S3

config GLINT_BOARD_CUSTOM
    bool "Custom board (main/boards/custom.h)"
    help
        Your own hardware. Copy main/boards/template.h to
        main/boards/custom.h and fill in the pin map; the build reports
        anything missing by name.

endchoice

config GLINT_ENABLE_WIFI
    bool "Serve the tile stream over Wi-Fi (SoftAP + TCP)"
    default y if GLINT_BOARD_S3_AMOLED175
    default n
    help
        Runs a SoftAP or joins a network, and serves a TCP listener feeding the
        same parser as USB. On the ESP32-P4 the radio is the onboard ESP32-C6
        reached over SDIO (esp-hosted); the C6 must already carry esp-hosted
        slave firmware.

config GLINT_WIFI_SSID
    string "Wi-Fi SSID to join (blank = run a SoftAP instead)"
    default ""
    depends on GLINT_ENABLE_WIFI
    help
        Joining an existing network is preferable when the host is on the same
        LAN: the host keeps its own connectivity and the panel is reachable at
        glint.local. Leave blank to fall back to a self-hosted SoftAP.

        Set this in the generated sdkconfig (which is gitignored), never in a
        committed defaults file — it is a credential.

config GLINT_WIFI_PASSWORD
    string "Wi-Fi password"
    default ""
    depends on GLINT_ENABLE_WIFI

endmenu
```

## firmware/sdkconfig.defaults.esp32s3
```kconfig
# ESP32-S3 boards (S3R8: octal PSRAM)
CONFIG_ESP_DEFAULT_CPU_FREQ_MHZ_240=y
CONFIG_SPIRAM_MODE_OCT=y
CONFIG_SPIRAM_SPEED_80M=y
```
